#include <dt-bindings/zmk/matrix_transform.h>
#include "corne_left.overlay"

&default_transform {
    col-offset = <6>;
};

/ {
    chosen {
        zmk,kscan = &kscan0;
        zmk,matrix_transform = &default_transform;
    };
};