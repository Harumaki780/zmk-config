## config/boards/shields/polaris/Kconfig.defconfig
```kconfig
if SHIELD_CORNE_LEFT || SHIELD_CORNE_RIGHT

config ZMK_KEYBOARD_NAME
    default "Corne"

endif
```

## config/boards/shields/polaris/Kconfig.shield
```kconfig
config SHIELD_POLARIS_LEFT
    def_bool $(shields_list_contains,polaris_left)

config SHIELD_POLARIS_RIGHT
    def_bool $(shields_list_contains,polaris_right)
```
